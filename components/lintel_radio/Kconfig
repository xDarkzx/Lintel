## components/lintel_radio/Kconfig
```kconfig
menu "Lintel LoRa"

    config LINTEL_LORA_FREQ_KHZ
        int "Frequency (kHz)"
        default 917000
        help
            Centre frequency. The default sits in the NZ/AU 915-928 MHz ISM band.

    config LINTEL_LORA_BW_KHZ
        int "Bandwidth (kHz)"
        default 250

    config LINTEL_LORA_SF
        int "Spreading factor"
        range 6 12
        default 7

    config LINTEL_LORA_CR
        int "Coding rate denominator (4/x)"
        range 5 8
        default 5

    config LINTEL_LORA_POWER_DBM
        int "TX power (dBm)"
        range -9 22
        default 14

    config LINTEL_LORA_PREAMBLE
        int "Preamble length (symbols)"
        default 12

    config LINTEL_LORA_SCK
        int "SPI SCK GPIO"
        default 9
    config LINTEL_LORA_MISO
        int "SPI MISO GPIO"
        default 11
    config LINTEL_LORA_MOSI
        int "SPI MOSI GPIO"
        default 10
    config LINTEL_LORA_NSS
        int "NSS GPIO"
        default 8
    config LINTEL_LORA_RST
        int "RESET GPIO"
        default 12
    config LINTEL_LORA_BUSY
        int "BUSY GPIO"
        default 13
    config LINTEL_LORA_DIO1
        int "DIO1 GPIO"
        default 14

    config LINTEL_LORA_TCXO_MV
        int "TCXO voltage on DIO3 (mV, 0 = crystal)"
        default 1800

    config LINTEL_LORA_DIO2_RF_SWITCH
        bool "DIO2 drives the RF switch"
        default y

endmenu
```

## firmware/door/main/Kconfig.projbuild
```kconfig
menu "Lintel door"

    config DOOR_PIN_LOCK
        int "Lock output GPIO (high = release)"
        default 5
        help
            Drives a MOSFET or relay board for the strike. Fail-secure strikes
            release when powered, so the default output state is low.

    config DOOR_PIN_CONTACT
        int "Door contact input GPIO (reed switch to GND, closed = shut)"
        default 6

    config DOOR_PIN_REX
        int "Request-to-exit button GPIO (to GND)"
        default 7

    config DOOR_PIN_TAMPER
        int "Tamper switch GPIO (to GND while the case is closed)"
        default 4

    config DOOR_HAS_SENSORS
        bool "Contact, exit and tamper inputs are wired"
        default n
        help
            Leave off on a bare board: floating inputs would raise false
            forced-open and tamper alarms.

    config DOOR_PIN_BUTTON
        int "User button GPIO (virtual card taps)"
        default 0

    config DOOR_PIN_LED
        int "Status LED GPIO"
        default 18

    config DOOR_PIN_VEXT
        int "Vext enable GPIO (powers the TFT on Wireless Tracker v1.1)"
        default 3

    config DOOR_TFT_CS
        int "TFT CS"
        default 38
    config DOOR_TFT_DC
        int "TFT DC"
        default 40
    config DOOR_TFT_RST
        int "TFT RESET"
        default 39
    config DOOR_TFT_SCLK
        int "TFT SCLK"
        default 41
    config DOOR_TFT_MOSI
        int "TFT MOSI"
        default 42
    config DOOR_TFT_BL
        int "TFT backlight"
        default 21
    config DOOR_TFT_X_OFFSET
        int "TFT column offset in landscape"
        default 1
    config DOOR_TFT_Y_OFFSET
        int "TFT row offset in landscape"
        default 26
    config DOOR_TFT_MADCTL
        hex "TFT MADCTL (rotation / colour order)"
        default 0x68
    config DOOR_TFT_INVERT
        bool "TFT needs colour inversion (IPS panels)"
        default y

endmenu
```

## firmware/door/sdkconfig.defaults
```kconfig
CONFIG_IDF_TARGET="esp32s3"
CONFIG_ESPTOOLPY_FLASHSIZE_8MB=y
CONFIG_COMPILER_OPTIMIZATION_PERF=y
CONFIG_COMPILER_CXX_EXCEPTIONS=n
CONFIG_ESP_CONSOLE_USB_SERIAL_JTAG=y
CONFIG_ESP_MAIN_TASK_STACK_SIZE=6144
CONFIG_FREERTOS_HZ=1000
CONFIG_MBEDTLS_HARDWARE_AES=y
CONFIG_MBEDTLS_HARDWARE_SHA=y
CONFIG_MBEDTLS_CMAC_C=y
CONFIG_MBEDTLS_CCM_C=y
CONFIG_LV_COLOR_DEPTH_16=y
CONFIG_LV_FONT_MONTSERRAT_12=y
CONFIG_LV_FONT_MONTSERRAT_14=y
CONFIG_LV_FONT_MONTSERRAT_24=y
CONFIG_LV_USE_LOG=n
```

## firmware/panel/main/Kconfig.projbuild
```kconfig
menu "Lintel panel"
    config PANEL_DOOR_NAME
        string "Door name shown on the panel"
        default "Main Entrance"
    config PANEL_WIFI_SSID
        string "Wi-Fi SSID (empty = use what the C6 has stored)"
        default ""
    config PANEL_WIFI_PASS
        string "Wi-Fi password"
        default ""
    config PANEL_SERVER_HOST
        string "Lintel server IP"
        default "192.168.87.10"
    config PANEL_SERVER_PORT
        int "Lintel server UDP port"
        default 47800
endmenu
```
